## drivers/net/wireless/rkwifi/Kconfig
```kconfig
config RKWIFI
   tristate "RK901/RK903/BCM4330 wireless cards support"
   default y
   depends on MMC && WLAN_80211
   select WIRELESS_EXT
   select WEXT_PRIV
   ---help---
     This module adds support for wireless adapters based on
     Broadcom 4329/30 chipset.

     This driver uses the kernel's wireless extensions subsystem.

     If you choose to build a module, it'll be called dhd. Say M if
     unsure.

config RK_CFG80211
   bool "Enable NL80211 support"
   default y
   depends on RKWIFI
   depends on CFG80211
   depends on MAC80211
   help
     Enables CFG80211 support
     
     
comment "CFG80211 and MAC80211 need to be enabled for RK_CFG80211"
   depends on RKWIFI && (!CFG80211 || !MAC80211)
```

## drivers/power/axp_power/Kconfig
```kconfig
menuconfig KP_AXP
	bool "X-Powers AXP Series Power drivers"
	select REGULATOR
	default n
	---help---
	  This option allows you to select X-Powers AXP power driver

if KP_AXP

choice
	prompt "AXP PMU type"
	default KP_AXP20

	config KP_AXP19
		bool "AXP19 driver"
		---help---
	  		AXP19 driver

	config KP_AXP20
		bool "AXP20 driver"
		---help---
	  		AXP20 driver

endchoice

choice
	prompt "AXP calculate type:"
	default USE_COL

	config USE_COL
		bool "COULOMB"
		---help---
			AXP driver for coulomb
		
	config USE_OCV
		bool "OCV"
		---help---
			AXP driver for ocv

endchoice

	config KP_OUTPUTINIT
		bool "AXP output init"
		default n
	
	config KP_USEIRQ
		bool "AXP irq enable"
		default y

	config AXP_DEBUG
		bool "AXP debug interface"
		select AXP_FRQSET
		select AXP_CHGCURCHG
		select AXP_CHGINIT
		select AXP_CHGVOLSET
		select AXP_CHGCURSET
		select AXP_CHGRATESET
		select AXP_PRECHGSET
		select AXP_CSTCHGSET
		select AXP_OPCLINIT
		select AXP_PEKSET
		select AXP_PEKOPEN
		select AXP_PEKLONG
		select AXP_PEKOFFEN
		select AXP_PEKDELAY
		select AXP_PEKOFF
		select AXP_NOESET
		select AXP_OTPOFFEN
		select AXP_OCVINIT
		select AXP_WARNVOL
		select AXP_USBVOLLIM
		select AXP_USBCURLIM
		default n

	config AXP_FRQSET
		bool "AXP adc frequency change"
		default n

	config AXP_CHGCURCHG
		bool "AXP charging current change when suspend\resume\shutdown"
		select AXP_CHGINIT
		select AXP_CHGCURSET
		default n

	menuconfig AXP_CHGINIT
		bool "AXP charge parameter set"
		default n
	
	if AXP_CHGINIT

		config AXP_CHGVOLSET
			bool "AXP change charge target voltage"
			default n
	
		config AXP_CHGCURSET
			bool "AXP change init charge current"
			default n
	
		config AXP_CHGRATESET
			bool "AXP change end charge current rate"
			default n

		config AXP_PRECHGSET
			bool "AXP pre-charge time set"
			default n

		config AXP_CSTCHGSET
			bool "AXP constant current charge time set"
			default n

	endif #!AXP_CHGINIT

	config AXP_PEKINFO
		bool "AXP set KEY_POWER information"
		default y

	menuconfig AXP_OPCLINIT
		bool "AXP pek n_oe overtemperture shutdown set"
		default n

	if AXP_OPCLINIT

		menuconfig AXP_PEKSET
			bool "AXP pek set"
			default n
		
		if AXP_PEKSET

			config AXP_PEKOPEN
				bool "AXP pek open time set"
				default n
	
			config AXP_PEKLONG
				bool "AXP pek long time set"
				default n

			config AXP_PEKOFFEN
				bool "AXP shutdown itself after press pek over off time"
				default n

			config AXP_PEKDELAY
				bool "AXP powerok delay time set"
				default n

			config AXP_PEKOFF
				bool "AXP pek shutdown time set"
				default n

		endif #!AXP_PEKSET

		config AXP_NOESET
			bool "AXP n_oe shutdown time set"
			default n	

		config AXP_OTPOFFEN
			bool "AXP shutdown itself after pmu overtemperture"
			default n

	endif #!AXP_OPCLINIT

	config AXP_OCVINIT
		bool "AXP ocv to capicaty table init set"
		default n

	config AXP_WARNVOL
		bool "AXP low warning voltage set"
		default n

	config AXP_USBVOLLIM
		bool "AXP usb voltage limite"
		default n
	
	config AXP_USBCURLIM
		bool "AXP usb current limite"
		default n

endif # !KP_AXP
```

## drivers/video/display/lcd/Kconfig
```kconfig
#
# LCD drivers configuration
#

config DISPLAY_LCD_SUPPORT
	bool "LCD Screen support"
	depends on DISPLAY_SUPPORT

config RK610_LCD
	bool "RK610(Jetta) lcd support"
	depends on MFD_RK610 && ARCH_RK29
	default y if MFD_RK610
	help
		Support Jetta(RK610) to output LCD1 and LVDS.
```

## drivers/video/display/tve/rk610/Kconfig
```kconfig
#
# TV Encoder RK610 drivers configuration
#

config RK610_TVOUT
	bool "RK610(Jetta) tvout support"
	depends on MFD_RK610
	default y if MFD_RK610
	help
		Support Jetta(RK610) to output YPbPr and CVBS.
		
config RK610_TVOUT_YPbPr
	bool "Support YPbPr Output"
	depends on RK610_TVOUT
config RK610_TVOUT_CVBS
	bool "Support CVBS Output"
	depends on RK610_TVOUT
```

## drivers/video/hdmi/Kconfig
```kconfig
#
# Display drivers configuration
#
menu "HDMI"
depends on ARCH_RK29
config HDMI
	bool "HDMI support"
    select FB_WORK_IPP
	select FB_SCALING_OSD
if HDMI
source "drivers/video/hdmi/chips/Kconfig"


config HDMI_SAVE_DATA
	bool "enable hdmi save data"	
	help 
		Enable hdmi save data in rtc register
		
config HDMI_DUAL_DISP
	bool "dual display support"
	depends on RK610_HDMI
	help
		Support output lcd and hdmi at the same time.

#config HDMI_DEBUG
#	bool "hdmi debug"
choice
	depends on RK610_HDMI
	prompt "HDMI DEFAULT OUT"
config HDMI_DEFAULT_OUT_HDMI
	bool "default hdmi"
config HDMI_DEFAULT_OUT_DVI
	bool "default dvi"
config HDMI_DEFAULT_OUT_DEPENDS_ON_EDID
	bool "depends on edid"
endchoice
endif

endmenu
```

## drivers/video/rockchip/chips/Kconfig
```kconfig
menuconfig LCDC_RK30
        tristate "rk30 lcdc support "
        depends on FB_ROCKCHIP
        help
          Driver for rk30 lcdc .There are two lcd controllers on rk30

config LCDC0_RK30
	bool "lcdc0 support"
	depends on LCDC_RK30
	default y
	help 
	   Support rk30 lcdc0 if you say y here

config LCDC1_RK30
        bool "lcdc1 support"
        depends on LCDC_RK30
        default y if HDMI_RK30
        help
           Support rk30 lcdc1 if you say y here
```
